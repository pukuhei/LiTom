&keymap {
    default_layer {
        bindings = <
&kp ESCAPE                                                                &kp BACKSPACE
&kp Q      &kp W         &kp E             &kp R           &kp T        &mo 6                      &kp BACKSLASH      &kp Y            &kp U     &kp I        &kp O         &kp P
&kp A      &kp S         &kp D             &kp F           &kp G        &mo 6                      &kp BACKSLASH      &kp H            &kp J     &kp K        &kp L         &kp MINUS
&kp Z      &kp X         &kp C             &kp V           &kp B        &kp LEFT_BRACKET           &kp RIGHT_BRACKET  &kp N            &kp M     &kp COMMA    &kp DOT       &lt 2 SLASH
&kp LCTRL  &kp LEFT_ALT  &kp LEFT_COMMAND  &kp LEFT_SHIFT  &lt 4 SPACE  &kp LG(SPACE)              &kp ENTER          &lt 3 BACKSPACE                         &lt 2 ESCAPE  &kp RIGHT_BRACKET
        >;

        sensor-bindings = <
            &tab_slide
            &scroll_up_down
            &scroll_up_down
        >;
    };
};
