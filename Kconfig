## Kconfig
```kconfig
config LITOM_PREFER_USB_ENDPOINT_ON_READY
    bool "Prefer USB endpoint when USB HID is ready"
    depends on ZMK_USB && ZMK_BLE
    help
      Switch the selected ZMK output endpoint back to USB whenever the USB HID
      endpoint becomes ready. This keeps BLE enabled for split transport while
      making host input prefer USB when a cable is connected.

config LITOM_AUTO_MOUSE_LAYER
    bool "LiTom trackball auto mouse layer"
    depends on INPUT
    help
      Activate a temporary mouse layer from trackball movement without using
      the generic temp-layer input processor.

if LITOM_AUTO_MOUSE_LAYER

config LITOM_AUTO_MOUSE_LAYER_TARGET
    int "Auto mouse layer index"
    default 1

config LITOM_AUTO_MOUSE_LAYER_SCROLL
    int "Scroll layer index that pauses auto mouse layer deactivation"
    default 2

config LITOM_AUTO_MOUSE_LAYER_TIMEOUT_MS
    int "Auto mouse layer timeout in milliseconds"
    default 400

module = LITOM_AUTO_MOUSE_LAYER
module-str = litom_auto_mouse_layer
source "${ZEPHYR_BASE}/subsys/logging/Kconfig.template.log_config"

endif

menuconfig LITOM_IQS7222D_TEST
    bool "IQS7222D touchpad test input driver"
    depends on I2C && GPIO && INPUT
    depends on DT_HAS_AZOTEQ_IQS7222D_TEST_ENABLED
    help
      Enable a lightweight IQS7222D test driver for bring-up. It verifies I2C
      communication, logs product/status data, and emits horizontal relative
      input from the reported trackpad X coordinate when configured.

if LITOM_IQS7222D_TEST

config LITOM_IQS7222D_TEST_INIT_PRIORITY
    int "IQS7222D test driver init priority"
    default INPUT_INIT_PRIORITY

module = LITOM_IQS7222D_TEST
module-str = litom_iqs7222d_test
source "${ZEPHYR_BASE}/subsys/logging/Kconfig.template.log_config"

endif
```

## config/boards/shields/LiTom/Kconfig.shield
```kconfig
config SHIELD_LITOM_R
    def_bool $(shields_list_contains,LiTom_R)

config SHIELD_LITOM_L
    def_bool $(shields_list_contains,LiTom_L)
```

## config/west.yml
```yaml
manifest:
  remotes:
    - name: cormoran
      url-base: https://github.com/cormoran
    - name: zmkfirmware
      url-base: https://github.com/zmkfirmware
    - name: mctechnology17
      url-base: https://github.com/mctechnology17
    - name: badjeff
      url-base: https://github.com/badjeff
    - name: englmaxi
      url-base: https://github.com/englmaxi
    - name: te9no
      url-base: https://github.com/te9no
    - name: pukuhei
      url-base: https://github.com/pukuhei
  projects:
    - name: zmk
      remote: cormoran
      revision: v0.3-branch+dya
      import: app/west.yml
    - name: zmk-module-ble-management
      remote: cormoran
      revision: main
    - name: zmk-module-battery-history
      remote: cormoran
      revision: main
    - name: zmk-module-settings-rpc
      remote: cormoran
      revision: main
    - name: zmk-module-runtime-input-processor
      remote: cormoran
      revision: main
    - name: zmk-behavior-runtime-sensor-rotate
      remote: cormoran
      revision: main
    - name: zmk-pmw3610-driver
      remote: badjeff
      revision: zmk-0.3
    - name: zmk-dongle-display
      remote: te9no
      revision: main
    - name: zmk-oled-adapter
      remote: mctechnology17
      revision: main
    - name: zmk-nice-oled
      remote: mctechnology17
      revision: main
    - name: zmk-tom-oled
      remote: pukuhei
      revision: main
  self:
    path: config
```
